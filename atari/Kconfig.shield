## hackerbrettle/Kconfig.defconfig
```kconfig
# Copyright (c) 2020 The ZMK Contributors
# SPDX-License-Identifier: MIT

if SHIELD_HACKERBRETTLE_LEFT

config ZMK_KEYBOARD_NAME
    default "HackerBrettLe"

config ZMK_SPLIT_ROLE_CENTRAL
    default y

endif

if SHIELD_HACKERBRETTLE_LEFT || SHIELD_HACKERBRETTLE_RIGHT

config ZMK_SPLIT
    default y

endif
```

## hackerbrettle/Kconfig.shield
```kconfig
# Copyright (c) 2020 The ZMK Contributors
# SPDX-License-Identifier: MIT

config SHIELD_HACKERBRETTLE_LEFT
    def_bool $(shields_list_contains,hackerbrettle_left)

config SHIELD_HACKERBRETTLE_RIGHT
    def_bool $(shields_list_contains,hackerbrettle_right)
```
